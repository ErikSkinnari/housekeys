## boards/shields/housekeys38/Kconfig.defconfig
```kconfig
if SHIELD_HOUSEKEYS38_LEFT

config ZMK_KEYBOARD_NAME
    default "housekeys38"

config ZMK_SPLIT_ROLE_CENTRAL
    default y

endif

if SHIELD_HOUSEKEYS38_LEFT || SHIELD_HOUSEKEYS38_RIGHT

config ZMK_SPLIT
    default y

endif
```

## boards/shields/housekeys38/Kconfig.shield
```kconfig
config SHIELD_HOUSEKEYS38_LEFT
    def_bool $(shields_list_contains, housekeys38_left)

config SHIELD_HOUSEKEYS38_RIGHT
    def_bool $(shields_list_contains, housekeys38_right)
```
