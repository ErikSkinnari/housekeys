/ {
    compatible = "zmk,keyboard";
    zmk,physical-layouts = <&default_layout>;

    default_layout: layout_0 {
        compatible = "zmk,physical-layout";

        key-positions = <
            -50  30  0   -30  30  0   -10  30  0   10  30  0   30  30  0    50  30  0   70  30  0   90  30  0  110  30  0  130  30  0
            -50  10  0   -30  10  0   -10  10  0   10  10  0   30  10  0    50  10  0   70  10  0   90  10  0  110  10  0  130  10  0
            -50 -10  0   -30 -10  0   -10 -10  0   10 -10  0   30 -10  0    50 -10  0   70 -10  0   90 -10  0 110 -10  0 130 -10  0
                       -30 -30  0   -10 -30  0    10 -30  0   30 -30  0    50 -30  0   70 -30  0   90 -30  0 110 -30  0
        >;
    };
};
